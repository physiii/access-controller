## access-controller/main/Kconfig.projbuild
```kconfig
menu "Power Configuration"

    config LED_STRIP_FLUSH_TIMEOUT
            int "makes esp-idf-lib work"
            default 12
            help
                This option selects the GPIO pin used for the main power signal.

    config I2CDEV_TIMEOUT
            int "makes esp-idf-lib work"
            default 1000
            help
                This option selects the GPIO pin used for the main power signal.

    config IGNITION_WIRE_IO
        int "Ignition power GPIO number"
        default 32
        help
            This option selects the GPIO pin used for the main power signal.

    config MAIN_POWER_IO
        int "Main power GPIO number"
        default 18
        help
            This option selects the GPIO pin used for the main power signal.

    config DISPLAY_POWER_IO
        int "Display power GPIO number"
        default 15
        help
            This option selects the GPIO pin used for the display power signal.

    config AUDIO_STBY_IO
        int "Audio standby power GPIO number"
        default 19
        help
            This option selects the GPIO pin used for the audio power signal.

    config AUDIO_MUTE_IO
      int "Audio mute power GPIO number"
      default 23
      help
            This option selects the GPIO pin used for the audio power signal.

endmenu

menu "CAN Configuration"

    config CAN_TX_GPIO_NUM
        int "TX GPIO number"
        default 5
        help
            This option selects the GPIO pin used for the TX signal. Connect the
            TX signal to your transceiver.

    config CAN_RX_GPIO_NUM
        int "RX GPIO number"
        default 4
        help
            This option selects the GPIO pin used for the RX signal. Connect the
            RX signal to your transceiver.

endmenu

menu "J1850 Configuration"

    config J1850_INPUT_PIN
        int "Input GPIO number"
        default 16
        help
            This option selects the GPIO pin used for the j1850 input signal.

    config J1850_OUTPUT_PIN
        int "Output GPIO number"
        default 17
        help
            This option selects the GPIO pin used for the j1850 output signal.

endmenu

menu "Wifi Configuration"

    config ESP_WIFI_SSID
        string "WiFi SSID"
        default "myssid"
        help
            SSID (network name) for the example to connect to.

    config ESP_WIFI_PASSWORD
        string "WiFi Password"
        default "mypassword"
        help
            WiFi password (WPA or WPA2) for the example to use.
    config ESP_WIFI_CHANNEL
        int "WiFi Channel"
        range 1 13
        default 1
        help
            WiFi channel (network channel) for the example to use.

    config ESP_MAX_STA_CONN
        int "Maximal STA connections"
        default 4
        help
            Max number of the STA connects to AP.
endmenu

menu "UART Configuration"

    config EXAMPLE_UART_PORT_NUM
        int "UART port number"
        range 0 2 if IDF_TARGET_ESP32
        range 0 1 if IDF_TARGET_ESP32S2
        default 2 if IDF_TARGET_ESP32
        default 1 if IDF_TARGET_ESP32S2
        help
            UART communication port number for the example.
            See UART documentation for available port numbers.

    config EXAMPLE_UART_BAUD_RATE
        int "UART communication speed"
        range 1200 115200
        default 115200
        help
            UART communication speed for Modbus example.

    config EXAMPLE_UART_RXD
        int "UART RXD pin number"
        range 0 34 if IDF_TARGET_ESP32
        range 0 46 if IDF_TARGET_ESP32S2
        default 5
        help
            GPIO number for UART RX pin. See UART documentation for more information
            about available pin numbers for UART.

    config EXAMPLE_UART_TXD
        int "UART TXD pin number"
        range 0 34 if IDF_TARGET_ESP32
        range 0 46 if IDF_TARGET_ESP32S2
        default 4
        help
            GPIO number for UART TX pin. See UART documentation for more information
            about available pin numbers for UART.

    config EXAMPLE_TASK_STACK_SIZE
        int "UART echo example task stack size"
        range 1024 16384
        default 2048
        help
            Defines stack size for UART echo example. Insufficient stack size can cause crash.

endmenu

menu "Http_File_Serving Example menu"

    config EXAMPLE_MOUNT_SD_CARD
        bool "Mount the SD card to the filesystem"
        default n
        help
            If this config item is set, the file you upload to server can be chosen to save in the SDcard.

    config EXAMPLE_FORMAT_IF_MOUNT_SDCARD_FAILED
        bool "The card will be formatted if mount has failed."
        default n
        depends on EXAMPLE_MOUNT_SD_CARD
        help
            If this config item is set, the card will be formatted if mount has failed.

    config EXAMPLE_USE_SDMMC_HOST
        bool "Use SDMMC host"
        default y
        depends on EXAMPLE_MOUNT_SD_CARD && IDF_TARGET_ESP32
        help
            If this config item is set, SDMMC is used to mount the SDcard.
            Otherwise, will use SPI host to access and mount the SDcard.

    config EXAMPLE_HTTPD_CONN_CLOSE_HEADER
        bool "Send connection close header from request handlers"
        default y
        help
            If this config item is set, Connection: close header will be set in handlers.
            This closes HTTP connection and frees the server socket instantly.
endmenu

menu "Access Point Configuration"

    config ESP_WIFI_SSID
        string "WiFi SSID"
        default "myssid"
        help
            SSID (network name) for the example to connect to.

    config ESP_WIFI_PASSWORD
        string "WiFi Password"
        default "mypassword"
        help
            WiFi password (WPA or WPA2) for the example to use.
    config ESP_WIFI_CHANNEL
        int "WiFi Channel"
        range 1 13
        default 1
        help
            WiFi channel (network channel) for the example to use.

    config ESP_MAX_STA_CONN
        int "Maximal STA connections"
        default 4
        help
            Max number of the STA connects to AP.
endmenu

menu "Example Configuration"

    config EXAMPLE_USE_SPI_ETHERNET
        bool

    choice EXAMPLE_ETHERNET_TYPE
        prompt "Ethernet Type"
        default EXAMPLE_USE_INTERNAL_ETHERNET if IDF_TARGET_ESP32
        default EXAMPLE_USE_W5500
        help
            Select which kind of Ethernet will be used in the example.

        config EXAMPLE_USE_INTERNAL_ETHERNET
            depends on IDF_TARGET_ESP32
            select ETH_USE_ESP32_EMAC
            bool "Internal EMAC"
            help
                Select internal Ethernet MAC controller.

        config EXAMPLE_USE_DM9051
            bool "DM9051 Module"
            select EXAMPLE_USE_SPI_ETHERNET
            select ETH_USE_SPI_ETHERNET
            select ETH_SPI_ETHERNET_DM9051
            help
                Select external SPI-Ethernet module (DM9051).

        config EXAMPLE_USE_W5500
            bool "W5500 Module"
            select EXAMPLE_USE_SPI_ETHERNET
            select ETH_USE_SPI_ETHERNET
            select ETH_SPI_ETHERNET_W5500
            help
                Select external SPI-Ethernet module (W5500).
    endchoice # EXAMPLE_ETHERNET_TYPE

    if EXAMPLE_USE_INTERNAL_ETHERNET
        choice EXAMPLE_ETH_PHY_MODEL
            prompt "Ethernet PHY Device"
            default EXAMPLE_ETH_PHY_IP101
            help
                Select the Ethernet PHY device to use in the example.

            config EXAMPLE_ETH_PHY_IP101
                bool "IP101"
                help
                    IP101 is a single port 10/100 MII/RMII/TP/Fiber Fast Ethernet Transceiver.
                    Goto http://www.icplus.com.tw/pp-IP101G.html for more information about it.

            config EXAMPLE_ETH_PHY_RTL8201
                bool "RTL8201/SR8201"
                help
                    RTL8201F/SR8201F is a single port 10/100Mb Ethernet Transceiver with auto MDIX.
                    Goto http://www.corechip-sz.com/productsview.asp?id=22 for more information about it.

            config EXAMPLE_ETH_PHY_LAN8720
                bool "LAN8720"
                help
                    LAN8720A is a small footprint RMII 10/100 Ethernet Transceiver with HP Auto-MDIX Support.
                    Goto https://www.microchip.com/LAN8720A for more information about it.

            config EXAMPLE_ETH_PHY_DP83848
                bool "DP83848"
                help
                    DP83848 is a single port 10/100Mb/s Ethernet Physical Layer Transceiver.
                    Goto http://www.ti.com/product/DP83848J for more information about it.

            config EXAMPLE_ETH_PHY_KSZ8041
                bool "KSZ8041"
                help
                    The KSZ8041 is a single supply 10Base-T/100Base-TX Physical Layer Transceiver.
                    Goto https://www.microchip.com/wwwproducts/en/KSZ8041 for more information about it.
        endchoice # EXAMPLE_ETH_PHY_MODEL

        config EXAMPLE_ETH_MDC_GPIO
            int "SMI MDC GPIO number"
            default 23
            help
                Set the GPIO number used by SMI MDC.

        config EXAMPLE_ETH_MDIO_GPIO
            int "SMI MDIO GPIO number"
            default 18
            help
                Set the GPIO number used by SMI MDIO.
    endif # EXAMPLE_USE_INTERNAL_ETHERNET

    if EXAMPLE_USE_SPI_ETHERNET
        config EXAMPLE_ETH_SPI_HOST
            int "SPI Host Number"
            range 0 2
            default 1
            help
                Set the SPI host used to communicate with the SPI Ethernet Controller.

        config EXAMPLE_ETH_SPI_SCLK_GPIO
            int "SPI SCLK GPIO number"
            range 0 33
            default 20
            help
                Set the GPIO number used by SPI SCLK.

        config EXAMPLE_ETH_SPI_MOSI_GPIO
            int "SPI MOSI GPIO number"
            range 0 33
            default 19
            help
                Set the GPIO number used by SPI MOSI.

        config EXAMPLE_ETH_SPI_MISO_GPIO
            int "SPI MISO GPIO number"
            range 0 33
            default 18
            help
                Set the GPIO number used by SPI MISO.

        config EXAMPLE_ETH_SPI_CS_GPIO
            int "SPI CS GPIO number"
            range 0 33
            default 21
            help
                Set the GPIO number used by SPI CS.

        config EXAMPLE_ETH_SPI_CLOCK_MHZ
            int "SPI clock speed (MHz)"
            range 5 80
            default 36
            help
                Set the clock speed (MHz) of SPI interface.

        config EXAMPLE_ETH_SPI_INT_GPIO
            int "Interrupt GPIO number"
            default 4
            help
                Set the GPIO number used by the SPI Ethernet module interrupt line.
    endif # EXAMPLE_USE_SPI_ETHERNET

    config EXAMPLE_ETH_PHY_RST_GPIO
        int "PHY Reset GPIO number"
        default 5
        help
            Set the GPIO number used to reset PHY chip.
            Set to -1 to disable PHY chip hardware reset.

    config EXAMPLE_ETH_PHY_ADDR
        int "PHY Address"
        range 0 31
        default 1
        help
            Set PHY address according your board schematic.
endmenu
```

## code-controller/main/Kconfig.projbuild
```kconfig
menu "Example Configuration"

    choice ESPNOW_WIFI_MODE
        prompt "WiFi mode"
        default ESPNOW_WIFI_MODE_STATION
        help
            WiFi mode(station or softap).

        config ESPNOW_WIFI_MODE_STATION
            bool "Station"
        config ESPNOW_WIFI_MODE_STATION_SOFTAP
            bool "Softap"
    endchoice

    config ESPNOW_PMK
        string "ESPNOW primary master key"
        default "pmk1234567890123"
        help
            ESPNOW primary master for the example to use. The length of ESPNOW primary master must be 16 bytes.

    config ESPNOW_LMK
        string "ESPNOW local master key"
        default "lmk1234567890123"
        help
            ESPNOW local master for the example to use. The length of ESPNOW local master must be 16 bytes.

    config ESPNOW_CHANNEL
        int "Channel"
        default 1
        range 1 13
        help
            The channel on which sending and receiving ESPNOW data.

    config ESPNOW_SEND_COUNT
        int "Send count"
        default 100
        range 1 65535
        help
            Total count of unicast ESPNOW data to be sent.

    config ESPNOW_SEND_DELAY
        int "Send delay"
        default 1000
        range 0 65535
        help
            Delay between sending two ESPNOW data, unit: ms.

    config ESPNOW_SEND_LEN
        int "Send len"
        range 10 250
        default 10
        help
            Length of ESPNOW data to be sent, unit: byte.

    config ESPNOW_ENABLE_LONG_RANGE
        bool "Enable Long Range"
        default "n"
        help
            When enable long range, the PHY rate of ESP32 will be 512Kbps or 256Kbps

endmenu

menu "Lightswitch Config"

    config LIGHT_1_IO
        int "LIGHT 1 IO"
        range 0 34
        default 25
        help
          GPIO number to control light 1.

    config LIGHT_2_IO
        int "LIGHT 2 IO"
        range 0 34
        default 26
        help
            GPIO number to control light 2.

    config SWITCH_1_IO
        int "SWITCH 1 IO"
        range 0 34
        default 12
        help
            GPIO number to control light 1.

    config SWITCH_2_IO
        int "SWITCH 2 IO"
        range 0 34
        default 13
        help
            GPIO number to control light 2.

    config LIGHT_OFF_TIME
        int "Delay time(m) turn off light"
        range 0 60000
        default 5
        help
            If no activity detected, turn off lights after this amount of minutes.
endmenu

menu "OTA Configuration"

    config EXAMPLE_FIRMWARE_UPGRADE_URL
        string "firmware upgrade url endpoint"
        default "http://open-automation.org:6000/controller.bin"
        help
            URL of server which hosts the firmware
            image.

    config EXAMPLE_FIRMWARE_UPGRADE_URL_FROM_STDIN
        bool
        default y if EXAMPLE_FIRMWARE_UPGRADE_URL = "FROM_STDIN"

    config EXAMPLE_SKIP_COMMON_NAME_CHECK
        bool "Skip server certificate CN fieldcheck"
        default n
        help
            This allows you to skip the validation of OTA server certificate CN field.

endmenu

menu "Wifi Configuration"

    config ESP_WIFI_SSID
        string "WiFi SSID"
        default "myssid"
        help
            SSID (network name) for the example to connect to.

    config ESP_WIFI_PASSWORD
        string "WiFi Password"
        default "mypassword"
        help
            WiFi password (WPA or WPA2) for the example to use.

    config ESP_MAXIMUM_RETRY
        int "Maximum retry"
        default 5
        help
            Set the Maximum retry to avoid station reconnecting to the AP unlimited when the AP is really inexistent.
endmenu
```
